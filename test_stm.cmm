; TRACE32 Auto Debug Script for TC364DP - STM Test Mode

CLOSE #1
CLOSE #2

OPEN #2 "C:\Users\swyoon\Desktop\MCAL TEST\TC364L_AS422_2_40_0_Init\t32_stm_log.txt" /Create
WRITE #2 "Starting STM Test Mode TRACE32 Debug Script..."
CLOSE #2

SYStem.RESet
SYStem.CPU TC364DP
SYStem.Up

IF !SYStem.Up()
(
   OPEN #2 "C:\Users\swyoon\Desktop\MCAL TEST\TC364L_AS422_2_40_0_Init\t32_stm_log.txt" /Append
   WRITE #2 "FAIL: Could not connect to TC364 board! Check hardware/cabling."
   CLOSE #2
   QUIT
)

OPEN #2 "C:\Users\swyoon\Desktop\MCAL TEST\TC364L_AS422_2_40_0_Init\t32_stm_log.txt" /Append
WRITE #2 "Connected to board successfully. Flashing ELF..."
CLOSE #2

DO "C:\T32\demo\tricore\flash\tc36x.cmm" CPU=TC364DP PREPAREONLY
FLASH.ReProgram ALL /Erase
Data.LOAD.Elf "C:\Users\swyoon\Desktop\MCAL TEST\TC364L_AS422_2_40_0_Init\Debug\TC364L_AS422_2_40_0_Init.elf"
FLASH.ReProgram off

Break.RESet
Break.Set Stm0_Sr0_Isr

OPEN #2 "C:\Users\swyoon\Desktop\MCAL TEST\TC364L_AS422_2_40_0_Init\t32_stm_log.txt" /Append
WRITE #2 "Flashing done! Booting and waiting for Stm0_Sr0_Isr (100ms LED) function..."
CLOSE #2

RunTime.RESet
Go
WAIT !run() 5.s
IF run()
(
   Break
   OPEN #2 "C:\Users\swyoon\Desktop\MCAL TEST\TC364L_AS422_2_40_0_Init\t32_stm_log.txt" /Append
   WRITE #2 "TIMEOUT: Stm0_Sr0_Isr breakpoint not hit."
   CLOSE #2
   QUIT
)

OPEN #2 "C:\Users\swyoon\Desktop\MCAL TEST\TC364L_AS422_2_40_0_Init\t32_stm_log.txt" /Append
WRITE #2 "SUCCESS: 1st hit at Stm0_Sr0_Isr!"
CLOSE #2

RunTime.Init
Go
WAIT !run() 5.s
IF run()
(
   Break
   OPEN #2 "C:\Users\swyoon\Desktop\MCAL TEST\TC364L_AS422_2_40_0_Init\t32_stm_log.txt" /Append
   WRITE #2 "TIMEOUT: Stm0_Sr0_Isr breakpoint not hit 2nd time."
   CLOSE #2
   QUIT
)

&time_diff_1=RunTime.LASTRUN()
OPEN #2 "C:\Users\swyoon\Desktop\MCAL TEST\TC364L_AS422_2_40_0_Init\t32_stm_log.txt" /Append
WRITE #2 "SUCCESS: 2nd hit at Stm0_Sr0_Isr!"
WRITE #2 "  -> Elapsed Time (expected ~100ms): " &time_diff_1
CLOSE #2

; --- LED2 Test (500ms interval for STM) ---
OPEN #2 "C:\Users\swyoon\Desktop\MCAL TEST\TC364L_AS422_2_40_0_Init\t32_stm_log.txt" /Append
WRITE #2 "Now Testing Stm0_Sr1_Isr (500ms interval)..."
CLOSE #2

Break.RESet
Break.Set Stm0_Sr1_Isr

&i=0.
WHILE &i<5.
(
    RunTime.Init
    Go
    WAIT !run() 5.s
    IF run()
    (
        Break
        OPEN #2 "C:\Users\swyoon\Desktop\MCAL TEST\TC364L_AS422_2_40_0_Init\t32_stm_log.txt" /Append
        WRITE #2 "TIMEOUT: Stm0_Sr1_Isr breakpoint not hit during LED2 test."
        CLOSE #2
        QUIT
    )

    &time_diff=RunTime.LASTRUN()
    OPEN #2 "C:\Users\swyoon\Desktop\MCAL TEST\TC364L_AS422_2_40_0_Init\t32_stm_log.txt" /Append
    WRITE #2 "  -> LED2 Test Tick " FORMAT.DECIMAL(0., &i+1.) ": " &time_diff
    CLOSE #2

    &i=&i+1.
)

OPEN #2 "C:\Users\swyoon\Desktop\MCAL TEST\TC364L_AS422_2_40_0_Init\t32_stm_log.txt" /Append
WRITE #2 "SUCCESS: Finished 5 ticks. LED2 successfully toggles every ~500ms!"
WRITE #2 "Automation Complete."
CLOSE #2

QUIT
